AUTOSAR XML (schema 00052)
package /Interfaces
  5 x sender receiver interface:
    EgoVehicleSpeed
      data EgoVehicleSpeed: category=VALUE, sw-calibration-access=READ-ONLY, type=float64
    LeadVehicleDistance
      data LeadVehicleDistance: category=VALUE, sw-calibration-access=READ-ONLY, type=float64
    LeadVehicleSpeed
      data LeadVehicleSpeed: category=VALUE, sw-calibration-access=READ-ONLY, type=float64
    BrakeCommand
      data BrakeCommand: category=VALUE, sw-calibration-access=READ-ONLY, type=float64
    AEB_Status
      data AEB_Status: category=VALUE, sw-calibration-access=READ-ONLY, type=float64
