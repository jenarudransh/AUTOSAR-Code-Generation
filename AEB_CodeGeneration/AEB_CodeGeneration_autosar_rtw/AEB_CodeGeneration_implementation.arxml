AUTOSAR XML (schema 00052)
package /Components/SwcImplementations
  swc implementation AEB_CodeGeneration_Impl: programming-language=C, sw-version=1.4.1, used-code-generator=Embedded Coder 25.1 (R2025a) 21-Nov-2024, vendor-id=0, behavior=AEB_CodeGeneration_IB
    code-descriptors:
      code Code
        artifact-descriptors:
          short-label=AEB_CodeGeneration_c, category=SWSRC
          short-label=AEBControlLogicUnit_c, category=SWSRC
          short-label=AEB_CodeGeneration_h, category=SWHDR
          short-label=AEB_CodeGeneration_private_h, category=SWHDR
          short-label=AEB_CodeGeneration_types_h, category=SWHDR
          short-label=AEBControlLogicUnit_h, category=SWHDR
          short-label=AEBControlLogicUnit_types_h, category=SWHDR
          short-label=AEBControlLogicUnit_private_h, category=SWHDR
    resource consumption RsrcCons_AEB_CodeGeneration
